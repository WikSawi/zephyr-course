## app/boards/my_custom_board/Kconfig.defconfig
```kconfig
if BOARD_MY_CUSTOM_BOARD

configdefault NET_L2_ETHERNET
	default y

endif # BOARD_MY_CUSTOM_BOARD
```

## app/boards/my_custom_board/board.yml
```yaml
board:
  name: my_custom_board
  full_name: My Custom Board
  vendor: st
  socs:
    - name: stm32f767xx
```

## app/boards/my_nucleo_f767zi/board.yml
```yaml
board:
  name: my_nucleo_f767zi
  full_name: My Nucleo F767ZI
  vendor: st
  socs:
    - name: stm32f767xx
```

## app/drivers/led_driver/Kconfig
```kconfig
config LED_DRIVER
    bool "LED Driver"
    default y
    help
      Enable support for the LED driver.
```

## dts/bindings/led,driver.yaml
```yaml
description: Device tree binding for a simple LED driver.
include: base.yaml

properties:
  gpios:
    type: phandle-array
    required: true
    description: "sensor used as LED control"
```
